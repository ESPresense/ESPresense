## sdkconfig.defaults.esp32
```kconfig
CONFIG_BT_NIMBLE_PINNED_TO_CORE_1=y
CONFIG_BTDM_CTRL_MODE_BLE_ONLY=y
CONFIG_ETH_USE_ESP32_EMAC=y
CONFIG_ESP_TASK_WDT_CHECK_IDLE_TASK_CPU1=n
CONFIG_BTDM_CTRL_BLE_MAX_CONN=2
CONFIG_BTDM_BLE_SCAN_DUPL=n
```
